## prj.conf
```kconfig
CONFIG_SCHED_MULTIQ=y
CONFIG_I2C=y
CONFIG_UART_CONSOLE=y

CONFIG_DEBUG=y
CONFIG_DEBUG_INFO=y
CONFIG_OPENOCD_SUPPORT=y

CONFIG_REBOOT=y

### Logging ###
CONFIG_LOG=y
CONFIG_LOG_PRINTK=y
CONFIG_LOG_BUFFER_SIZE=2048
CONFIG_LOG_RUNTIME_FILTERING=y
CONFIG_LOG_PROCESS_TRIGGER_THRESHOLD=0
CONFIG_LOG_DEFAULT_LEVEL=4
CONFIG_LOG_OVERRIDE_LEVEL=4
CONFIG_LOG_MAX_LEVEL=4

CONFIG_KERNEL_LOG_LEVEL=4
CONFIG_KERNEL_LOG_LEVEL_DBG=y

CONFIG_GPIO_LOG_LEVEL=4
CONFIG_GPIO_LOG_LEVEL_DBG=y

CONFIG_SENSOR_LOG_LEVEL=4
CONFIG_SENSOR_LOG_LEVEL_DBG=y

CONFIG_I2C_LOG_LEVEL=4
CONFIG_I2C_LOG_LEVEL_DBG=y

CONFIG_IEEE802154_LOG_LEVEL=4
CONFIG_IEEE802154_LOG_LEVEL_DBG=y

CONFIG_SOC_LOG_LEVEL=4
CONFIG_SOC_LOG_LEVEL_DBG=y

CONFIG_ARCH_LOG_LEVEL=4
CONFIG_ARCH_LOG_LEVEL_DBG=y

CONFIG_MPU_LOG_LEVEL=4
CONFIG_MPU_LOG_LEVEL_DBG=y

CONFIG_FLASH_LOG_LEVEL=4
CONFIG_FLASH_LOG_LEVEL_DBG=y

CONFIG_NET_BUF_LOG_LEVEL=4
CONFIG_NET_BUF_LOG_LEVEL_DBG=y

CONFIG_SHELL_LOG_LEVEL=4
CONFIG_SHELL_LOG_LEVEL_DBG=y

# CONFIG_MAIN_LOG_LEVEL=4
# CONFIG_MAIN_LOG_LEVEL_DBG=y

CONFIG_NET_STATISTICS=y

CONFIG_SENSOR=y
CONFIG_BME280=y

# Networking
CONFIG_NETWORKING=y
CONFIG_NET_UDP=y

# Kernel options
CONFIG_ENTROPY_GENERATOR=y
CONFIG_TEST_RANDOM_GENERATOR=y
CONFIG_INIT_STACKS=y

# Flash settings
CONFIG_FLASH=y
CONFIG_FLASH_PAGE_LAYOUT=y

# Thread by default registers quite a lot addresses.
CONFIG_NET_IF_UNICAST_IPV6_ADDR_COUNT=6
CONFIG_NET_IF_MCAST_IPV6_ADDR_COUNT=8

CONFIG_CMU_HFCLK_HFXO=y
CONFIG_CMU_HFXO_FREQ=38400000
```

## debug.conf
```kconfig
CONFIG_HAS_SEGGER_RTT=y
CONFIG_USE_SEGGER_RTT=y
CONFIG_RTT_CONSOLE=y
```

## efr32mg-tb2.conf
```kconfig
CONFIG_NET_L2_IEEE802154=y
CONFIG_NET_L2_IEEE802154_SHELL=y
CONFIG_MPU_ALLOW_FLASH_WRITE=y
CONFIG_IEEE802154_EFR32=y
```

## src/main.c
```c
/*
 * Copyright (c) 2012-2014 Wind River Systems, Inc.
 *
 * SPDX-License-Identifier: Apache-2.0
 */

#include <zephyr.h>
#include <misc/printk.h>

#include <logging/log.h>

#include <device.h>
#include <sensor.h>

struct sensor_value press;

LOG_MODULE_REGISTER(main);

void main(void)
{
	LOG_INF("Hello World! %s\n", CONFIG_ARCH);
	LOG_WRN("Foo");

	struct device *dev = device_get_binding("BME280");
	if (dev == NULL)
	{
		LOG_ERR("Could not get BME280 device\n");
		return;
	}
	while (true)
	{
		if (sensor_sample_fetch(dev) < 0)
		{
			LOG_ERR("Sensor sample update error\n");
			return;
		}

		sensor_sample_fetch(dev);
		sensor_channel_get(dev, SENSOR_CHAN_PRESS, &press);

		LOG_INF("press: %d.%06d\n",
					press.val1, press.val2);

		k_sleep(1000);
	}
}
```
